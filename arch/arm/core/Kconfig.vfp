## subsys/shell/modules/Kconfig
```kconfig
# Shell configuration options

# Copyright (c) 2016 Intel Corporation
# SPDX-License-Identifier: Apache-2.0

config DEVICE_SHELL
	bool "Device shell"
	default y if !SHELL_MINIMAL
	help
	  This shell provides access to basic device data.

config DEVICE_SHELL_INIT_CMD
	bool "Device shell init command"
	depends on DEVICE_SHELL
	default y if !SHELL_MINIMAL
	help
	  Add an 'init' command to the device shell module in order
	  to initialize, at runtime and manually, the devices that
	  own the 'zephyr,deferred-init' attribute. Note that if you
	  enable CONFIG_DEVICE_DEPS, it will take dependencies into
	  account.

config DATE_SHELL
	bool "Date shell"
	default y if !SHELL_MINIMAL
	help
	  This shell provides access to date and time based on Unix time.

config DEVMEM_SHELL
	bool "Devmem shell"
	default y if !SHELL_MINIMAL
	select GETOPT
	help
	  This shell command provides read/write access to physical memory.

config APP_VERSION_SHELL
	bool "Application version information shell"
	default y if !SHELL_MINIMAL
	depends on "$(APP_VERSION_EXTENDED_STRING)" != ""
	help
	  This shell command provides read access to application version information.

config ZYCLICTEST_SHELL
	bool "Zyclictest shell"
	select POSIX_C_LIB_EXT
	help
	  This shell command provides latency measurement.
	  Measure latencies of interrupt service routines and threads when
	  woken up by a timer. Collecting data in the background while
	  application of interrest is running in the foreground.
	  It can be switched on by demand and measure the worst case latencies
	  with the exact circumstances of the productive application. Thus one
	  can see if for example interrupts or preemption locks are preventing
	  the application to run.
	  Inspired by Linux cyclictest tool.

config PERF_SHELL
	bool "perf-like PMU shell (perf start / stop / report)"
	depends on SHELL
	depends on HAS_PMU
	default n
	help
	  Register Zephyr shell commands similar to Linux perf for interactive
	  PMU use: "perf start [-e <event>|help]", "perf list", "perf stop", and
	  "perf report". Uses the architecture-neutral PMU API in pmu.h (for example
	  the AArch64 backend behind CONFIG_ARM64_PMU). Intended as a separate
	  change set stacked on the PMU driver PR; enable CONFIG_ARM64_PMU (or
	  another backend selecting HAS_PMU) on the board.

rsource "kernel_service/Kconfig"
```

## tests/benchmarks/cpu_performance/testcase.yaml
```yaml
tests:
  benchmarks.cpu_performance:
    tags:
      - benchmark
      - cpu
      - pmu
      - arm64
    arch_allow:
      - arm64
    platform_allow:
      - qemu_cortex_a53
      - qemu_cortex_a72
      - amd_versal_net_ipp_xcvn1752_revb
    integration_platforms:
      - qemu_cortex_a53
    harness: console
    harness_config:
      type: multi_line
      regex:
        - "Benchmark Suite Complete"
```

## tests/kernel/smp_cache/testcase.yaml
```yaml
tests:
  kernel.smp.cache:
    tags:
      - kernel
      - smp
      - cache
    filter: CONFIG_SMP and CONFIG_CACHE_MANAGEMENT
    min_ram: 64
    platform_exclude:
      - qemu_x86
    arch_exclude:
      - posix
```
