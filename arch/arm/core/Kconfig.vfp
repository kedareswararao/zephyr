## arch/arm/core/Kconfig.vfp
```kconfig
# SPDX-License-Identifier: Apache-2.0
# Copyright (c) 2022 Lexmark International, Inc.

# ARM architecture VFP configuration options

# Math coprocessor symbols; these should be selected by the CPU symbol to
# indicate that the CPU core can be configured with the specified
# coprocessor(s).

config CPU_HAS_VFP
	bool
	select CPU_HAS_FPU
	imply FPU
	imply FPU_SHARING
	help
	  This option signifies the support for a Vectored Floating-Point (VFP)
	  coprocessor.

config CPU_HAS_NEON
	bool
	select CPU_HAS_FPU
	help
	  This option signifies the support for a NEON (Advanced SIMD) coprocessor.

# VFP type symbols; these should be selected by the SoC symbol to specify the
# type of the VFP core instantiated by the SoC.

config VFP_SP_D16
	bool
	select CPU_HAS_VFP
	select VFP_FEATURE_SINGLE_PRECISION
	select VFP_FEATURE_REGS_S32_D16
	help
	  This option signifies the use of a VFP floating-point coprocessor
	  that supports only single-precision operations with 16 double-word
	  registers.

config VFP_SP_D16_FP16
	bool
	select CPU_HAS_VFP
	select VFP_FEATURE_HALF_PRECISION
	select VFP_FEATURE_SINGLE_PRECISION
	select VFP_FEATURE_REGS_S32_D16
	help
	  This option signifies the use of a VFP floating-point coprocessor
	  that supports half- and single-precision operations with 16
	  double-word registers.

config VFP_SP_D16_FP16_FMAC
	bool
	select CPU_HAS_VFP
	select VFP_FEATURE_HALF_PRECISION
	select VFP_FEATURE_SINGLE_PRECISION
	select VFP_FEATURE_FMAC
	select VFP_FEATURE_REGS_S32_D16
	help
	  This option signifies the use of a VFP floating-point coprocessor
	  that supports half- and single-precision operations (including fused
	  multiply-accumulate) with 16 double-word registers.

config VFP_DP_D16
	bool
	select CPU_HAS_VFP
	select VFP_FEATURE_SINGLE_PRECISION
	select VFP_FEATURE_DOUBLE_PRECISION
	select VFP_FEATURE_REGS_S32_D16
	help
	  This option signifies the use of a VFP floating-point coprocessor
	  that supports single- and double-precision operations with 16
	  double-word registers.

config VFP_DP_D16_FP16
	bool
	select CPU_HAS_VFP
	select VFP_FEATURE_HALF_PRECISION
	select VFP_FEATURE_SINGLE_PRECISION
	select VFP_FEATURE_DOUBLE_PRECISION
	select VFP_FEATURE_REGS_S32_D16
	help
	  This option signifies the use of a VFP floating-point coprocessor
	  that supports half-, single- and double-precision operations with 16
	  double-word registers.

config VFP_DP_D16_FP16_FMAC
	bool
	select CPU_HAS_VFP
	select VFP_FEATURE_HALF_PRECISION
	select VFP_FEATURE_SINGLE_PRECISION
	select VFP_FEATURE_DOUBLE_PRECISION
	select VFP_FEATURE_FMAC
	select VFP_FEATURE_REGS_S32_D16
	help
	  This option signifies the use of a VFP floating-point coprocessor
	  that supports half-, single- and double-precision operations
	  (including fused multiply-accumulate) with 16 double-word registers.

config VFP_U_DP_D16_FP16_FMAC
	bool
	select CPU_HAS_VFP
	select VFP_FEATURE_HALF_PRECISION
	select VFP_FEATURE_SINGLE_PRECISION
	select VFP_FEATURE_DOUBLE_PRECISION
	select VFP_FEATURE_FMAC
	select VFP_FEATURE_REGS_S32_D16
	select VFP_FEATURE_TRAP
	help
	  This option signifies the use of a VFP floating-point coprocessor
	  that supports half-, single-, double-precision operations (including
	  fused multiply-accumulate) and floating-point exception trapping with 16
	  double-word registers.

config VFP_DP_D32
	bool
	select CPU_HAS_VFP
	select VFP_FEATURE_SINGLE_PRECISION
	select VFP_FEATURE_DOUBLE_PRECISION
	select VFP_FEATURE_REGS_S64_D32
	help
	  This option signifies the use of a VFP floating-point coprocessor
	  that supports single- and double-precision operations
	  with 32 double-word registers.

config VFP_DP_D32_FP16_FMAC
	bool
	select CPU_HAS_VFP
	select VFP_FEATURE_HALF_PRECISION
	select VFP_FEATURE_SINGLE_PRECISION
	select VFP_FEATURE_DOUBLE_PRECISION
	select VFP_FEATURE_FMAC
	select VFP_FEATURE_REGS_S64_D32
	help
	  This option signifies the use of a VFP floating-point coprocessor
	  that supports half-, single- and double-precision operations
	  (including fused multiply-accumulate) with 32 double-word registers.

config VFP_U_DP_D32_FP16_FMAC
	bool
	select CPU_HAS_VFP
	select VFP_FEATURE_HALF_PRECISION
	select VFP_FEATURE_SINGLE_PRECISION
	select VFP_FEATURE_DOUBLE_PRECISION
	select VFP_FEATURE_FMAC
	select VFP_FEATURE_REGS_S64_D32
	select VFP_FEATURE_TRAP
	help
	  This option signifies the use of a VFP floating-point coprocessor
	  that supports half-, single-, double-precision operations (including
	  fused multiply-accumulate) and floating-point exception trapping with 32
	  double-word registers.

if CPU_HAS_VFP

# VFP feature symbols; these are the helper symbols used by the floating-point
# support code to resolve the supported VFP features.

config VFP_FEATURE_HALF_PRECISION
	bool
	help
	  This option signifies that the VFP coprocessor supports
	  half-precision operations (half-precision extension).

config VFP_FEATURE_SINGLE_PRECISION
	bool
	help
	  This option signifies that the VFP coprocessor supports
	  single-precision operations.

config VFP_FEATURE_DOUBLE_PRECISION
	bool
	select CPU_HAS_FPU_DOUBLE_PRECISION
	help
	  This option signifies that the VFP coprocessor supports
	  double-precision operations.

config VFP_FEATURE_VECTOR
	bool
	help
	  This option signifies that the VFP coprocessor supports vector
	  operations.

config VFP_FEATURE_FMAC
	bool
	help
	  This option signifies that the VFP coprocessor supports the fused
	  multiply-accumulate operations.

config VFP_FEATURE_REGS_S32_D16
	bool
	help
	  This option signifies that the VFP coprocessor implements 16
	  double-precision (32 single-precision) floating-point registers.

config VFP_FEATURE_REGS_S64_D32
	bool
	help
	  This option signifies that the VFP coprocessor implements 32
	  double-precision (64 single-precision) floating-point registers.

config VFP_FEATURE_TRAP
	bool
	help
	  This option signifies that the VFP coprocessor supports the trapping
	  of floating-point exceptions to allow software implementation of
	  the unsupported VFP instructions.

endif # CPU_HAS_VFP

# Advanced SIMD type symbols; these should be selected by the SoC symbol to
# specify the type of the VFP core instantiated by the SoC.

config NEON
	bool
	select CPU_HAS_NEON
	help
	  This option signifies the use of a NEON Advanced SIMD coprocessor.

choice FPU_SHARING_MODE
	prompt "FPU register sharing mode"
	depends on FPU_SHARING
	depends on CPU_AARCH32_CORTEX_A || CPU_AARCH32_CORTEX_R
	default FPU_SHARING_EAGER
	help
	  Selects how the VFP register file is preserved across thread context
	  switches on AArch32 Cortex-A/R.

config FPU_SHARING_LAZY
	bool "Lazy"
	help
	  The VFP is disabled on exception entry and the register file is saved
	  and restored on demand: the first FP access after a switch takes an
	  undefined-instruction trap that enables the VFP and spills the previous
	  owner. Cheapest when a thread does not touch the FPU between switches,
	  and it lets interrupt service routines use the FPU safely.

config FPU_SHARING_EAGER
	bool "Eager"
	help
	  Default scheme. Save and restore the full VFP register file eagerly on
	  every thread context switch (d0-d15 on S32_D16 parts, d0-d31 on S64_D32
	  parts). The VFP is kept enabled for floating-point threads, so the switch
	  does a single contiguous store/load of the register file with no
	  per-switch disable/re-enable and no undefined-instruction trap on the
	  first FP access after a switch. This lowers the context-switch latency
	  for floating-point-heavy workloads at the cost of always saving the FP
	  registers of a floating-point thread, even when it does not touch the FPU
	  between switches.

	  Interrupts are still taken with the VFP disabled, so an interrupt service
	  routine that uses the FPU is handled safely; it costs the interrupted
	  thread a single re-enable trap on its next FP access.

endchoice
```

## arch/arm64/core/Kconfig.pmu
```kconfig
# Copyright (c) 2026 Advanced Micro Devices, Inc.
# SPDX-License-Identifier: Apache-2.0

# ARM64 PMU configuration

config ARM64_PMU
	bool "ARMv8-A PMUv3 support"
	depends on ARM64
	select HAS_PMU
	help
	  Enable support for ARM Performance Monitoring Unit (PMU).
	  The PMU provides hardware performance counters for monitoring
	  CPU behavior including cache misses, branch mispredictions,
	  memory accesses, and cycle counts.

	  This driver supports ARMv8-A PMUv3 and is compatible with all
	  Cortex-A processors (A53, A55, A57, A72, A73, A75, A76, A77, A78,
	  A510, A710, X1, X2, etc.)

if ARM64_PMU

config ARM64_PMU_INIT_PRIORITY
	int "PMU initialization priority"
	default 50
	help
	  Initialization priority for the PMU driver. This determines when
	  the PMU is initialized during boot relative to other subsystems.
	  Lower values initialize earlier.

config ARM64_PMU_USER_ACCESS
	bool "User-mode access to PMU counters"
	help
	  Allow unprivileged (user-mode) applications to access PMU counters.
	  This is useful for benchmarking but may have security implications.

	  WARNING: Enabling this allows any user-space code to read performance
	  counters, which could leak sensitive timing information.

module = ARM64_PMU
module-str = ARM64 PMU
source "subsys/logging/Kconfig.template.log_config"

endif # ARM64_PMU
```

## boards/amd/zynqmp_apu/Kconfig.defconfig
```kconfig
# Copyright (c) 2026 Advanced Micro Devices, Inc.
# SPDX-License-Identifier: Apache-2.0

if BOARD_ZYNQMP_APU

config BUILD_OUTPUT_BIN
	default y

config ZYNQMP_SMP_FARM_GDB
	bool "Pin synchronization sample threads to CPU0 for farm GDB"
	depends on SMP
	help
	  When enabled (via boards/amd/zynqmp_apu/support/thread_debug_smp_farm.conf),
	  samples/synchronization pins both threads to CPU 0 instead of CPU 0+1.
	  Required for hw_server GDB and OpenOCD XVC on the board farm (CPU0 only).
	  Sets CONFIG_MP_MAX_NUM_CPUS=1 so z_smp_init does not hang under debugger attach.

endif # BOARD_ZYNQMP_APU
```

## drivers/debug/Kconfig.coresight_xlnx
```kconfig
# AMD Xilinx CoreSight driver configuration

config CORESIGHT_XLNX
	bool "CoreSight driver for AMD Xilinx Versal/VersalNet"
	depends on ARM64
	depends on SOC_AMD_VERSALNET || SOC_XLNX_VERSAL || SOC_XLNX_VERSAL2
	default y if BOARD_VERSALNET_APU
	help
	  Enable CoreSight trace support for AMD Xilinx Versal and VersalNet
	  platforms. This driver supports:
	  - ETM (Embedded Trace Macrocell) for CPU instruction tracing
	  - TMC/ETR (Trace Memory Controller) for trace capture to memory
	  - Funnel for merging trace from multiple CPU cores

	  This is useful for debugging, profiling, and code coverage analysis
	  on Cortex-A78 processors.

if CORESIGHT_XLNX

config CORESIGHT_XLNX_AUTO_INIT
	bool "Auto-initialize CoreSight on boot"
	default y
	help
	  Automatically initialize CoreSight components during system boot.
	  If disabled, the application must call coresight_xlnx_init() manually.

config CORESIGHT_XLNX_INIT_PRIORITY
	int "CoreSight driver initialization priority"
	default 50
	help
	  Initialization priority for the CoreSight driver. This determines
	  when the driver is initialized during boot relative to other subsystems.

config CORESIGHT_XLNX_BUFFER_SIZE
	int "Trace buffer size in bytes"
	default 4096
	range 1024 1048576
	help
	  Size of the trace buffer for storing ETM trace data.
	  Larger buffers can capture more trace data but use more memory.
	  The buffer must be at least 1KB and at most 1MB.
	  For production use, 64KB-256KB is recommended.

config CORESIGHT_XLNX_TRACE_ID
	int "ETM trace ID"
	default 1
	range 1 70
	help
	  Unique trace source ID for this CPU's ETM output.
	  Each trace source in the system must have a unique ID.
	  Valid range is 1-70.

config CORESIGHT_XLNX_TIMESTAMP
	bool "Enable global timestamps in trace"
	default y
	help
	  Enable global timestamp packets in the trace stream.
	  This allows correlating trace data with wall-clock time.

config CORESIGHT_XLNX_CYCLE_ACCURATE
	bool "Enable cycle-accurate tracing"
	default n
	help
	  Enable cycle counting in trace output. This increases trace
	  bandwidth but provides precise timing information.

config CORESIGHT_XLNX_BRANCH_BROADCAST
	bool "Enable branch broadcast"
	default n
	help
	  Enable branch broadcast tracing. This records all branch targets,
	  not just indirect branches, providing more complete trace but
	  increasing trace bandwidth significantly.

config CORESIGHT_XLNX_RETURN_STACK
	bool "Enable return stack"
	default y
	help
	  Enable the return stack feature for more efficient tracing of
	  function call/return sequences.

module = CORESIGHT_XLNX
module-str = CoreSight Xilinx
source "subsys/logging/Kconfig.template.log_config"

endif # CORESIGHT_XLNX
```

## dts/bindings/debug/xlnx,coresight-1.0.yaml
```yaml
# Copyright (c) 2026 AMD
# SPDX-License-Identifier: Apache-2.0

description: |
  AMD Xilinx CoreSight trace controller for Versal/VersalNet platforms.

  This node represents the CoreSight debug and trace infrastructure,
  including support for ETM (Embedded Trace Macrocell) CPU instruction
  tracing and TMC/ETR (Trace Memory Controller) trace capture.

  Example:
    coresight: coresight@f0800000 {
      compatible = "xlnx,coresight-1.0";
      reg = <0x0 0xf0800000 0x0 0x4000>;
      status = "okay";

      trace-buffer-size = <65536>;
      trace-id = <1>;
    };

compatible: "xlnx,coresight-1.0"

include: base.yaml

properties:
  reg:
    required: true
    description: |
      Base address and size of the CoreSight register block.

  trace-buffer-size:
    type: int
    default: 4096
    description: |
      Size of the trace buffer in bytes. Must be a power of 2.
      Recommended values: 4096 (4KB), 65536 (64KB), 262144 (256KB).

  trace-id:
    type: int
    default: 1
    description: |
      Unique trace source ID for this CoreSight instance.
      Valid range is 1-70. Each trace source must have a unique ID.

  etm-base:
    type: int
    description: |
      Base address of the ETM (Embedded Trace Macrocell) for CPU0.
      If not specified, defaults to 0xF0841000 for Versal Net.

  tmc-base:
    type: int
    description: |
      Base address of the TMC/ETR (Trace Memory Controller).
      If not specified, defaults to 0xF0803000 for Versal Net.

  funnel-base:
    type: int
    description: |
      Base address of the trace funnel.
      If not specified, defaults to 0xF0802000 for Versal Net.

  enable-timestamps:
    type: boolean
    description: |
      Enable global timestamps in trace output.

  enable-cycle-counting:
    type: boolean
    description: |
      Enable cycle-accurate tracing. Increases trace bandwidth.

  enable-branch-broadcast:
    type: boolean
    description: |
      Enable branch broadcast tracing. Records all branch targets.

  enable-return-stack:
    type: boolean
    description: |
      Enable return stack for efficient function tracing.
```

## kernel/Kconfig.pmu
```kconfig
# Copyright (c) 2026 Advanced Micro Devices, Inc.
# SPDX-License-Identifier: Apache-2.0

config HAS_PMU
	bool
	help
	  Set when a hardware PMU backend implements <zephyr/pmu.h> (e.g.
	  CONFIG_ARM64_PMU, or future ARMv8-R / RISC-V HPM options). Used to
	  express dependencies in Kconfig and tests.
```

## subsys/devicetree/Kconfig
```kconfig
# Copyright (c) 2026 Advanced Micro Devices, Inc.
# SPDX-License-Identifier: Apache-2.0

config DT_RECONFIGURABLE
	bool "Runtime-reconfigurable devicetree resources"
	help
	  Enable a RAM-backed descriptor table for devicetree nodes marked with
	  the "zephyr,reconfigurable" property. Each descriptor is seeded from the
	  node's devicetree reg/interrupts and may be patched at runtime from a
	  manifest (for example on an FPGA dynamic-function-exchange segment switch)
	  before the owning device is (re)initialized. This provides dynamic
	  devicetree resource handling without a runtime flattened devicetree (FDT)
	  blob on the target. Descriptors are created with DT_RECONFIGURABLE_DEFINE().
```
